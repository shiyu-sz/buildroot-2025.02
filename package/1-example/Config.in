## package/1-example/Config.in
```kconfig
menu "1-example"

source "package/1-example/example_backtrace/Config.in"
source "package/1-example/example_c/Config.in"
source "package/1-example/example_qt/Config.in"
source "package/1-example/raspberrypi5_overlay/Config.in"
source "package/1-example/lv_port_linux_v9/Config.in"

endmenu
```

## package/1-example/example_backtrace/Config.in
```kconfig
config BR2_PACKAGE_EXAMPLE_BACKTRACE
bool "example_backtrace"
help
  example_backtrace.
```

## package/1-example/example_qt/Config.in
```kconfig
menuconfig BR2_PACKAGE_EXAMPLE_QT
	bool "example_qt"
	default n
	select BR2_PACKAGE_QT5
	help
	  QT App.
```

## package/raspberrypi5_overlay/Config.in
```kconfig
config BR2_PACKAGE_RASPBERRYPI5_OVERLAY
bool "raspberrypi5_overlay"
help
  raspberrypi5_overlay.
```

## package/rlottie/Config.in
```kconfig
config BR2_PACKAGE_RLOTTIE
    bool "rlottie"
    select BR2_PACKAGE_HOST_CMAKE
    help
        rlottie.
```

## package/ydotool/Config.in
```kconfig
config BR2_PACKAGE_YDOTOOL
    bool "ydotool"
    select BR2_PACKAGE_HOST_CMAKE
    help
        ydotool.
```
